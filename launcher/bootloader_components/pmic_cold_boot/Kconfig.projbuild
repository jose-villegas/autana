## launcher/bootloader_components/pmic_cold_boot/Kconfig.projbuild
```kconfig
menu "PMIC cold boot"

    config PMIC_COLD_BOOT_HOST_DRAIN
        bool "Hold the reset until the host has read the crash output"
        default n
        help
            The PMIC power cycle drops the USB-Serial/JTAG port, and the host
            loses whatever it had not read yet. A development or diagnostics
            build waits before the cycle; a release build does not.

endmenu
```

## launcher/main/Kconfig.projbuild
```kconfig
menu "Launcher"

    choice LAUNCHER_BUILD_TYPE
        prompt "Build type"
        default LAUNCHER_RELEASE
        help
            What this build is for. Exactly one of these is ever true, so
            code can check CONFIG_LAUNCHER_DEVELOPMENT and know it means
            "not a release build" - not "development, or maybe something
            else nobody has named yet."

        config LAUNCHER_RELEASE
            bool "Release"
            help
                The product, and nothing else. No test suites, no profiling
                counters, no logging meant to be read over a serial console.
                This project does not do telemetry - nobody downstream is
                ever reading those numbers - so anything a developer alone
                would want is pure cost here: flash for the strings, cycles
                for the bookkeeping, for output that helps nobody. None of
                it ships in this build.

        config LAUNCHER_DEVELOPMENT
            bool "Development"
            help
                Turns on everything meant for someone AT the device or
                watching its serial console while working on it - frame
                timing, step counters, that kind of thing. Guard code with
                CONFIG_LAUNCHER_DEVELOPMENT, not CONFIG_LAUNCHER_SELFTEST,
                unless what it is actually gating is the test suites
                themselves - see LAUNCHER_SELFTEST below, which requires
                this rather than turning it on for you. Turn this on by itself for a build that wants
                the profiling and logging without the test suites too.

    endchoice

    config LAUNCHER_SELFTEST
        bool "Include the on-device test suites"
        default n
        depends on LAUNCHER_DEVELOPMENT
        help
            Compiles the test suites into the firmware and runs them at boot,
            before the shell starts.

            Off by default, so a normal build carries no test code at all.
            The suites draw to the framebuffer and drive the panel, which is
            harmless in a diagnostics build and unacceptable in a shipped one,
            and test hooks in a release image are a liability rather than a
            feature.

            Turn this on through the diagnostics build rather than by hand:

                autana selftest

            which builds this variant into its own directory, flashes it,
            collects the results over the serial console and exits non-zero if
            anything failed.

    config LAUNCHER_SELFTEST_AUTORUN
        bool "Run the on-device test suites automatically at boot"
        depends on LAUNCHER_SELFTEST
        default n
        help
            LAUNCHER_SELFTEST above compiles the suites in; this decides
            whether they also RUN automatically at boot, versus sitting
            compiled-in until triggered on demand from the Diagnostics app's
            toggle screen.

            Off by default. The suite count has grown well past the "roughly
            half a second" boot/selftest.c's own comment once described, so
            paying that cost on every boot of an interactive diagnostics
            session - just to check the POST report or flip a toggle - makes
            the build too slow to use for anything else. Turn this on only
            for an automated harness that needs the suites to run
            themselves: build_flash.sh --diag --autorun layers
            sdkconfig.defaults.diag_autorun on top of sdkconfig.defaults.diag
            for exactly that reason, and every report script that captures a
            whole run goes through it.

    config LAUNCHER_QEMU
        bool "The image runs under Espressif's QEMU, with no board attached"
        depends on LAUNCHER_DEVELOPMENT
        default n
        help
            QEMU's esp32s3 machine has no panel, I/O expander or touch
            controller, so board identification fails and graphics never
            starts. With this on, an unidentified board gets a null panel
            instead: a strip counts as sent once its transfer time at the
            panel clock has passed, and the framebuffer, the present task
            and everything drawn through them run as they do on the board.
            A missing touch controller is likewise replaced by one that
            reports what touch_inject() sets, and a missing IMU by one that
            reports what imu_inject() sets; the console listener takes TOUCH
            and IMU lines for both.

            Set only by sdkconfig.defaults.qemu, which also carries the
            flash and console settings QEMU needs. On a board that
            identifies itself this changes nothing.

    choice LAUNCHER_SELFTEST_SCOPE
        prompt "Which suites the self-test image carries"
        depends on LAUNCHER_SELFTEST
        default LAUNCHER_SELFTEST_SCOPE_FULL
        help
            LAUNCHER_SELFTEST above compiles the suites in; this decides
            WHICH of them get compiled at all. Scoped around what a run
            READS rather than around folders - see the two entries below.

            Full is the default and must stay that way: a scope is opt-in
            precisely so that coverage can never shrink by accident.

        config LAUNCHER_SELFTEST_SCOPE_FULL
            bool "Full - every suite"
            help
                Every suite in the tree, shell-owned and app-owned alike.
                This is what autana selftest and report_test_results.sh
                want: a gate is only a gate if it runs everything.

        config LAUNCHER_SELFTEST_SCOPE_PERF
            bool "Perf - suites apps declare for a performance capture"
            help
                Only the sources declared by apps in scope_perf.cmake are
                compiled. Everything else is absent from the image, which
                buys back the static-RAM headroom a capture needs.

                It is also a build closer to release layout in the 32 KB
                instruction cache. That is a better instrument on a
                fetch-bound workload, but it means absolute numbers from a
                perf-scoped capture compare only within that capture or
                other perf-scoped captures, never against an unscoped one.

                NOT a test gate: it drops behaviour coverage on purpose.
                Never take a merge decision from a perf-scoped run.

    endchoice

    config LAUNCHER_GFX_QSPI_80MHZ
        bool "Drive the panel's QSPI bus at 80 MHz until a saved choice says otherwise"
        default y
        help
            Halves the time a full frame spends on the bus: 8.2 ms at 80 MHz
            against 16.5 at 40, and a measured full present of 17.6 ms says
            there is no software slack left at the lower clock. The display
            transfer is the largest single cost in a frame, so this is the
            biggest lever on the board.

            There is no in-between. The 80 MHz source's integer divider
            (n >= 2 floor) resolves to exactly 40 or 80, so this is a bool
            rather than a frequency.

            Needs every strip sent from internal DMA RAM, never read in place
            from PSRAM: DMA from PSRAM shares the PSRAM bus's bandwidth, and at
            80 MHz the panel receives dropped data (gfx.c, strip_bounce).

            80 MHz is outside the panel's own rating: the CO5300 datasheet
            (6.4) gives a 50 MHz write maximum, 6.5 ns clock high/low (80
            gives 6.25) and 10 ns CS setup, and every panel pin reaches it
            through the GPIO matrix. A renderer that redraws only dirty
            regions shows the result as stray pixels or thin lines that
            stay until that region is sent again with a different window
            layout; a renderer redrawing whole frames hides it within one
            frame. 40 MHz is clean. Even-edged windows are still required
            at either clock, but do not make 80 clean.

            The dirty-band thresholds in gfx.h were fitted to 40 MHz timings
            and are wrong until re-measured - some of the win leaks back
            otherwise.

    choice LAUNCHER_GFX_BAND_HEIGHT
        prompt "Band ring height (GFX_LAYOUT_BANDS)"
        default LAUNCHER_GFX_BAND_HEIGHT_32
        help
            Rows per band buffer for a full-redraw renderer's internal-SRAM
            band ring (gfx.h) - a divisor of 448. 32 is the default absent
            a device sweep saying otherwise; tools/sweeps/band_height_sweep.sh
            builds one image per choice for that sweep.

        config LAUNCHER_GFX_BAND_HEIGHT_16
            bool "16 rows"

        config LAUNCHER_GFX_BAND_HEIGHT_32
            bool "32 rows"

        config LAUNCHER_GFX_BAND_HEIGHT_64
            bool "64 rows"

    endchoice

    config LAUNCHER_GFX_QSPI_STRONG_PADS
        bool "Drive the QSPI pads at 40 mA instead of the 20 mA default"
        default n
        help
            Raises drive capability on the four data lines and the clock,
            sharpening their edges. Applied after spi_bus_initialize(), which
            is what configures those pads - set before it and the driver
            overwrites it.

            Only meaningful alongside the 80 MHz option above: at 40 MHz the
            link has margin to spare and this changes nothing measurable. At
            80 it does not clear the partial-redraw corruption described
            under that option: the clock is out of the panel's spec, which
            sharper edges cannot fix.

endmenu
```

## launcher/packages/hash/Kconfig
```kconfig
menu "Hash"

    choice HASH_CRC32_IMPLEMENTATION
        prompt "CRC-32 implementation"
        default HASH_CRC32_ROM

        config HASH_CRC32_ROM
            bool "ROM"

        config HASH_CRC32_NIBBLE
            bool "Nibble reference"

    endchoice

endmenu
```

## launcher/packages/math/Kconfig
```kconfig
menu "Math"

    config MATH_FPU_RECIP
        bool "Use FPU reciprocal seeds"
        default y
        help
            Use the ESP32-S3 FPU recip0.s and rsqrt0.s seeds. Disable where
            the emulator lacks these instructions (Espressif QEMU).

    config MATH_CLAMPS
        bool "Use the Xtensa clamps instruction"
        default y
        help
            Use the ESP32-S3 signed clamp instruction for int16 saturation.
            Disable where the emulator lacks this instruction.

    config MATH_FPU_FUSED_MADD
        bool "Use FPU fused multiply-add"
        default y
        help
            Rely on madd.s/msub.s rounding once. Disable where the emulator
            rounds the product (Espressif QEMU).

endmenu
```

## launcher/packages/math/test_apps/sdkconfig.defaults
```kconfig
CONFIG_COMPILER_OPTIMIZATION_PERF=y
CONFIG_APP_RETRIEVE_LEN_ELF_SHA=13
CONFIG_ESP_TASK_WDT_INIT=n
CONFIG_UNITY_ENABLE_64BIT=y
```

## launcher/packages/simd/Kconfig
```kconfig
menu "SIMD"

    config SIMD_PIE
        bool "Use the PIE vector unit"
        depends on IDF_TARGET_ESP32S3
        default y
        help
            Run the simd calls on the ESP32-S3 PIE vector unit (128-bit
            integer lanes).

endmenu
```

## launcher/packages/testkit/Kconfig
```kconfig
menu "Testkit"
    config TESTKIT_QEMU
        bool "Run under QEMU"
        default n
endmenu
```
